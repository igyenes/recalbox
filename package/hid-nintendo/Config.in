## package/hid-nintendo/Config.in
```kconfig
config BR2_PACKAGE_DKMS_HID_NINTENDO
	bool "hid-nintendo"
	help
	  A Nintendo HID kernel module.  
```

## package/joycond/Config.in
```kconfig
config BR2_PACKAGE_JOYCOND
	bool "joycond"
	select BR2_PACKAGE_LIBEVDEV
	select BR2_PACKAGE_EUDEV
	help
    joycond is a linux daemon which uses the evdev devices provided
    by hid-nintendo (formerly known as hid-joycon) to implement
    joycon pairing.
```
